## Config.in
```kconfig
source "$BR2_EXTERNAL_VPN_PI_PATH/package/Config.in"

menu "PIkev2 Configuration"

config PIKEV2_DOMAIN_NAME
	string "VPN Domain Name"
	default ""
	help
		Domain name used for the VPN

choice
	prompt "Letsencrypt Challenge Type"
	default DNS_01
	help
	  Set the optimization level for gcc

config DNS_01
	bool "DNS-01"
	help
		Use acme.sh to do a dns challenge using txt records
		Best uption if using dynamic dns provided by DYNU
	select BR2_PACKAGE_ACMESH

config HTTP_01
	bool "HTTP-01"
	help
		Use certbot to do HTTP challenges
		Best option if using static ip

endchoice

choice
	prompt "VPN Authentication"
	default EAP_MSCHAPV2
	help
	  Select how to authenticate with the VPN

config EAP_MSCHAPV2
	bool "EAP-MSCHAPV2"
	help
		Authenticaiton using preshared user and pass set by a text file
		This is the simplest form but is prone to week passwords
	select BR2_PACKAGE_EAP_MSCHAPV2_CONFIGS

config EAP_TLS
	bool "EAP-TLS"
	help
		EAP-TLS autentication uses server and client certificates
		to perform mutual authentication. This is the most secure
		but requires maintenance of PKI.

endchoice

if BR2_PACKAGE_EAP_MSCHAPV2_CONFIGS
	config PIKEV2_USER1
		string "username 1"
	config PIKEV2_PASS1
		string "password 1"

	config PIKEV2_USER2
		string "username 2"
	config PIKEV2_PASS2
		string "password 2"

	config PIKEV2_USER3
		string "username 3"
	config PIKEV2_PASS3
		string "password 3"
endif

endmenu
```

## configs/raspberrypi4_vpn_pi_defconfig
```kconfig
BR2_arm=y
BR2_cortex_a72=y
BR2_ARM_FPU_NEON_VFPV4=y
BR2_SSP_STRONG=y
BR2_RELRO_FULL=y
BR2_FORTIFY_SOURCE_2=y
BR2_TOOLCHAIN_BUILDROOT_GLIBC=y
BR2_PACKAGE_HOST_LINUX_HEADERS_CUSTOM_4_19=y
BR2_TOOLCHAIN_BUILDROOT_CXX=y
BR2_TARGET_GENERIC_HOSTNAME="vpn_pi"
BR2_TARGET_GENERIC_ISSUE="Welcome to vpn_pi"
BR2_TARGET_GENERIC_PASSWD_SHA512=y
BR2_ROOTFS_DEVICE_TABLE="system/device_table.txt $(BR2_EXTERNAL_VPN_PI_PATH)/board/raspberrypi4_vpn/local_skeleton_permissions_raspberrypi4_vpn.txt"
BR2_SYSTEM_DHCP="eth0"
BR2_ROOTFS_OVERLAY="$(BR2_EXTERNAL_VPN_PI_PATH)/board/raspberrypi4_vpn/local_skeleton_raspberrypi4_vpn"
BR2_ROOTFS_POST_BUILD_SCRIPT="board/raspberrypi4/post-build.sh"
BR2_ROOTFS_POST_IMAGE_SCRIPT="board/raspberrypi4/post-image.sh"
BR2_ROOTFS_POST_SCRIPT_ARGS="--add-miniuart-bt-overlay"
BR2_LINUX_KERNEL=y
BR2_LINUX_KERNEL_CUSTOM_TARBALL=y
BR2_LINUX_KERNEL_CUSTOM_TARBALL_LOCATION="$(call github,raspberrypi,linux,64d0a9870ac14d5eb5253f67d984ae348eec1393)/linux-64d0a9870ac14d5eb5253f67d984ae348eec1393.tar.gz"
BR2_LINUX_KERNEL_DEFCONFIG="bcm2711"
BR2_LINUX_KERNEL_DTS_SUPPORT=y
BR2_LINUX_KERNEL_INTREE_DTS_NAME="bcm2711-rpi-4-b"
BR2_LINUX_KERNEL_NEEDS_HOST_OPENSSL=y
BR2_PACKAGE_LZ4=y
BR2_PACKAGE_RPI_FIRMWARE=y
BR2_PACKAGE_RPI_FIRMWARE_VARIANT_PI4=y
BR2_PACKAGE_PYTHON3=y
BR2_PACKAGE_PYTHON3_SSL=y
BR2_PACKAGE_LZO=y
BR2_PACKAGE_GMP=y
BR2_PACKAGE_DROPBEAR=y
BR2_PACKAGE_IPTABLES=y
BR2_PACKAGE_STRONGSWAN=y
BR2_PACKAGE_STRONGSWAN_OPENSSL=y
BR2_PACKAGE_STRONGSWAN_EAP=y
BR2_PACKAGE_UACME=y
BR2_TARGET_ROOTFS_EXT2=y
BR2_TARGET_ROOTFS_EXT2_4=y
BR2_TARGET_ROOTFS_EXT2_SIZE="120M"
# BR2_TARGET_ROOTFS_TAR is not set
BR2_PACKAGE_HOST_DOSFSTOOLS=y
BR2_PACKAGE_HOST_GENIMAGE=y
BR2_PACKAGE_HOST_MTOOLS=y
```

## package/Config.in
```kconfig
source "$BR2_EXTERNAL_VPN_PI_PATH/package/acmesh/Config.in"
source "$BR2_EXTERNAL_VPN_PI_PATH/package/eap-mschapv2-configs/Config.in"
```

## package/acmesh-crontab/Config.in
```kconfig
config BR2_PACKAGE_ACMESH_CRONTAB
	bool
	help
		Setup the crontab for automatic reenrollment of certificates using acme.sh
```

## package/acmesh/Config.in
```kconfig
config BR2_PACKAGE_ACMESH
	bool
	help
		An ACME protocol client written purely in Shell (Unix shell) language.
	select BR2_PACKAGE_BUSYBOX_SHOW_OTHERS
	select BR2_PACKAGE_BASH
	select BR2_PACKAGE_LIBCURL
	select BR2_PACKAGE_LIBCURL_CURL
	select BR2_PACKAGE_LIBOPENSSL_BIN
	select BR2_PACKAGE_LIBIDN
	select BR2_PACKAGE_LIBIDN_BINARY
	select BR2_PACKAGE_SOCAT
	select BR2_PACKAGE_CA_CERTIFICATES
```

## package/eap-mschapv2-configs/Config.in
```kconfig
config BR2_PACKAGE_EAP_MSCHAPV2_CONFIGS
	bool
	help
		Use simple MSCHAPV2 config files
	select BR2_PACKAGE_STRONGSWAN
	select BR2_PACKAGE_STRONGSWAN_OPENSSL
	select BR2_PACKAGE_STRONGSWAN_EAP
```
